## app/boards/shields/why-kb-split/Kconfig.defconfig
```kconfig
if SHIELD_why_LEFT

config ZMK_KEYBOARD_NAME
    default "why-kb"

config ZMK_SPLIT_ROLE_CENTRAL
    default y

endif

if SHIELD_why_LEFT || SHIELD_why_RIGHT

config ZMK_SPLIT
    default y

endif
```

## app/boards/shields/why-kb-split/Kconfig.shield
```kconfig
# Copyright (c) 2020 The ZMK Contributors
# SPDX-License-Identifier: MIT

config SHIELD_why_LEFT
    def_bool $(shields_list_contains,why_left)

config SHIELD_why_RIGHT
    def_bool $(shields_list_contains,why_right)
```

## app/boards/shields/why50/Kconfig.defconfig
```kconfig
# Copyright (c) 2020 The ZMK Contributors
# SPDX-License-Identifier: MIT

if SHIELD_why50

config ZMK_KEYBOARD_NAME
	default "why Keyboard"

endif
```
